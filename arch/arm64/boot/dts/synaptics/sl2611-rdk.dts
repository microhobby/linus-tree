// SPDX-License-Identifier: (GPL-2.0 OR MIT)
/*
 * Copyright (C) 2025 Synaptics Incorporated
 *
 * Author: Jisheng Zhang <jszhang@kernel.org>
 */

/dts-v1/;

#include "sl2611.dtsi"
#include "sl261x-rdk-common.dtsi"

/ {
	model = "Synaptics SL2611 RDK";
	compatible = "syna,sl2611-rdk", "syna,sl2611";
};
