// SPDX-License-Identifier: (GPL-2.0 OR MIT)
/*
 * Copyright (C) 2025 Synaptics Incorporated
 *
 * Author: Jisheng Zhang <jszhang@kernel.org>
 */

/dts-v1/;

#include "sl2613.dtsi"
#include "sl261x-rdk-common.dtsi"

/ {
	model = "Synaptics SL2613 RDK";
	compatible = "syna,sl2613-rdk", "syna,sl2613";
};

&gpu {
	status = "okay";
};

&smmu {
	status = "okay";
};

&synpu {
	status = "okay";
};
